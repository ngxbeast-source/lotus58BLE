/* ---- STEP 1: DEFINE LAYERS ---- */
#define ABC 0
#define XTRA 1
#define XTR2 2
#define XTR3 3
#define XTR4 4
#define GAME 5
#define G1_1 6
#define GG8 7
#define GME2 8
#define G2_1 9
#define GME3 10
#define G3_1 11
#define GME4 12
#define G4_1 13
#define GATE 14
#define T1 15
#define T1_1 16
#define T1_2 17
#define T1_3 18
#define T1_4 19
#define T2 20
#define T2_1 21
#define T2_2 22
#define T2_3 23
#define T2_4 24

/* ---- STEP 1a: DEFINE COLORS ---- */
#define RGB_ABC RGB_COLOR_HSB(19,100,17)      /* BASE        - Dim Yellow */
#define RGB_XTRA RGB_COLOR_HSB(183,45,18)      /* SUB-LAYOUT  - Teal */
#define RGB_XTR2 RGB_COLOR_HSB(230,87,26)      /* SUB-LAYOUT  - Pale Blue */
#define RGB_XTR3 RGB_COLOR_HSB(273,67,23)      /* SUB-LAYOUT  - Light Purple */
#define RGB_XTR4 RGB_COLOR_HSB(116,67,26)      /* SUB-LAYOUT  - Pale Green */
#define RGB_GAME RGB_COLOR_HSB(0,100,25)      /* SUB-BASE    - Red */
#define RGB_G1_1 RGB_COLOR_HSB(116,67,50)      /* SUB-LAYOUT - Bright Yellow */
#define RGB_GG8 RGB_COLOR_HSB(200,100,60)      /* GATEWAY - Cyan */
#define RGB_GME2 RGB_COLOR_HSB(73,67,15)      /* SUB-BASE    - Dim Emerald */
#define RGB_G2_1 RGB_COLOR_HSB(73,55,40)      /* SUB-LAYOUT */
#define RGB_GME3 RGB_COLOR_HSB(58,100,21)      /* SUB-BASE */
#define RGB_G3_1 RGB_COLOR_HSB(58,55,40)      /* SUB-LAYOUT */
#define RGB_GME4 RGB_COLOR_HSB(138,100,18)      /* SUB-BASE */
#define RGB_G4_1 RGB_COLOR_HSB(138,55,40)      /* SUB-LAYOUT */
#define RGB_GATE RGB_COLOR_HSB(251,67,60)      /* GATEWAY - Indigo */
#define RGB_T1 RGB_COLOR_HSB(40,50,12)      /* SUB-BASE  - Yellow */
#define RGB_T1_1 RGB_COLOR_HSB(58,50,20)      /* SUB-LAYOUT */
#define RGB_T1_2 RGB_COLOR_HSB(211,50,40)      /* SUB-LAYOUT */
#define RGB_T1_3 RGB_COLOR_HSB(291,50,40)      /* SUB-LAYOUT */
#define RGB_T1_4 RGB_COLOR_HSB(51,50,40)      /* SUB-LAYOUT */
#define RGB_T2 RGB_COLOR_HSB(85,75,15)      /* SUB-BASE  - Lime */
#define RGB_T2_1 RGB_COLOR_HSB(44,75,40)      /* SUB-LAYOUT  - Bright Lime */
#define RGB_T2_2 RGB_COLOR_HSB(74,75,38)      /* SUB-LAYOUT */
#define RGB_T2_3 RGB_COLOR_HSB(125,75,40)      /* SUB-LAYOUT */
#define RGB_T2_4 RGB_COLOR_HSB(175,75,40)      /* SUB-LAYOUT */

/* ---- (OPTIONAL) BLINK HELPERS ---- */
#define RGB_BLINK_ON RGB_COLOR_HSB(39,100,75)      /* Blink On - Bright Yellow (change to whatever you want, multiple colors can be made like shown below) */
#define RGB_N_BLINK_ON RGB_COLOR_HSB(0,100,60)      /* Num On - Bright Red */
#define RGB_C_BLINK_ON RGB_COLOR_HSB(200,100,60)      /* Caps On - Cyan */

/* ---- HELPER DEFINITIONS ---- */
#define BLINK_SEQ(ON, OFF, WAIT) \
    &macro_tap &rgb_ug ON \
    &macro_wait_time WAIT \
    &macro_tap &rgb_ug RGB_TOG \
    &macro_wait_time WAIT \
    &macro_tap &rgb_ug RGB_TOG \
    &macro_wait_time WAIT \
    &macro_tap &rgb_ug RGB_TOG \
    &macro_wait_time WAIT \
    &macro_tap &rgb_ug RGB_TOG \
    &macro_wait_time WAIT \
    &macro_tap &rgb_ug OFF
#define MO_RGB(node_name, node_label, layer, active_color, release_color) \
        ZMK_MACRO(node_name, \
            bindings = \
                <&macro_press>, \
                <&mo layer>, \
                <&macro_tap>, \
                <&rgb_ug active_color>, \
                <&macro_pause_for_release>, \
                <&macro_release>, \
                <&mo layer>, \
                <&macro_tap>, \
                <&rgb_ug release_color>; \
            label = node_label; \
        )
#define TO_RGB(node_name, node_label, layer, color) \
        ZMK_MACRO(node_name, \
            bindings = \
                <&macro_tap>, \
                <&to layer>, \
                <&macro_tap>, \
                <&rgb_ug color>; \
            label = node_label; \
        )
#define TO_RGB_PRESS(node_name, node_label, layer, color) \
        ZMK_MACRO(node_name, \
            bindings = \
                <&macro_tap>, \
                <&to layer>, \
                <&macro_press>, \
                <&rgb_ug color>; \
            label = node_label; \
        )
#define RGB_HT(node_name, node_label, macro_ref) \
        node_name: node_name { \
            compatible = "zmk,behavior-hold-tap"; \
            label = node_label; \
            bindings = <&macro_ref>, <&kp>; \
            #binding-cells = <2>; \
            tapping-term-ms = <200>; \
            flavor = "tap-preferred"; \
            quick-tap-ms = <180>; \
            global-quick-tap; \
        };
#define CMB(name, bind, keypos, ...) \
    name { bindings = <bind>; key-positions = <keypos>; layers = <__VA_ARGS__>; timeout-ms = <50>; }
/* EXPERIMENTAL: Blink helper - Hardcode a &kp you want to "blink", used in conjunction with tap-dance*/
#define KP_BLINK(node_name, node_label, key, blink_color, return_color, wait) \
         ZMK_MACRO(node_name, \
            label = node_label; \
            bindings = <&macro_tap &kp key>, \
            <BLINK_SEQ(blink_color, return_color, wait)>; \
        )
 /{
    /* ---- STEP 2+3: MACROS ---- */
    macros {
        /* Toggled and momentary macros for RGB layers */
        /* Momentary Layers/Sub-Layouts:
        These are bound to a hold-tap behavior for full effect */
        MO_RGB(mo_rgb_xtr4, "Base_4 MoRGB: OR USE HT RGB", XTR4, RGB_XTR4, RGB_ABC)
        MO_RGB(mo_rgb_xtra2, "Base_2 MoRGB: OR USE HT RGB", XTR2, RGB_XTR2, RGB_ABC)
        MO_RGB(mo_rgb_xtr3, "Base_3 MoRGB: OR USE HT RGB", XTR3, RGB_XTR3, RGB_ABC)
        MO_RGB(mo_rgb_xtra, "Base_1 MoRGB: OR USE HT RGB", XTRA, RGB_XTRA, RGB_ABC)
        MO_RGB(mo_rgb_g1_s1, "Game1_1 MoRGB: OR USE HT RGB", G1_1, RGB_G1_1, RGB_GAME)
        MO_RGB(mo_rgb_t2_s1, "Base2_1 MoRGB: OR USE HT RGB", T2_1, RGB_T2_1, RGB_T2)
        MO_RGB(mo_rgb_t1_s1, "Base1_1 MoRGB: OR USE HT RGB", T1_1, RGB_T1_1, RGB_T1)
        MO_RGB(mo_rgb_g2_s1, "Game2_1 MoRGB: OR USE HT RGB", G2_1, RGB_G2_1, RGB_GME2)
        MO_RGB(mo_rgb_g3_s1, "Game3_1 MoRGB: OR USE HT RGB", G3_1, RGB_G3_1, RGB_GME3)
        MO_RGB(mo_rgb_g4_s1, "Game4_1 MoRGB: OR USE HT RGB", G4_1, RGB_G4_1, RGB_GME4)
        MO_RGB(mo_rgb_t1_s2, "Base1_2 MoRGB: OR USE HT RGB", T1_2, RGB_T1_2, RGB_T1)
        MO_RGB(mo_rgb_t1_s3, "Base1_3 MoRGB: OR USE HT RGB", T1_3, RGB_T1_3, RGB_T1)
        MO_RGB(mo_rgb_t1_s4, "Base1_4 MoRGB: OR USE HT RGB", T1_4, RGB_T1_4, RGB_T1)
        MO_RGB(mo_rgb_t2_s2, "Base2_2 MoRGB: OR USE HT RGB", T2_2, RGB_T2_2, RGB_T2)
        MO_RGB(mo_rgb_t2_s3, "Base2_3 MoRGB: OR USE HT RGB", T2_3, RGB_T2_3, RGB_T2)
        MO_RGB(mo_rgb_t2_s4, "Base2_4 MoRGB: OR USE HT RGB", T2_4, RGB_T2_4, RGB_T2)
        /* Sub-Base Toggles:
        These are bound straight to the keymap, OR to a combo. */
        TO_RGB(to_rgb_default, "To Base RGB;USED FOR COMBO", ABC, RGB_ABC)
        TO_RGB(to_rgb_game, "To Game1 RGB;USED FOR COMBO", GAME, RGB_GAME)
        TO_RGB(to_rgb_t1, "To Base1 RGB;USE IN GATEWAY LAYER", T1, RGB_T1)
        TO_RGB(to_rgb_t2, "To Base2 RGB;USE IN GATEWAY LAYER", T2, RGB_T2)
        TO_RGB(to_rgb_g2, "To Game2 RGB;USE IN GAMEGATE LAYER", GME2, RGB_GME2)
        TO_RGB(to_rgb_g3, "To Game3 RGB;USE IN GAMEGATE LAYER", GME3, RGB_GME3)
        TO_RGB(to_rgb_g4, "To Game4 RGB;USE IN GAMEGATE LAYER", GME4, RGB_GME4)
        //Gateways
        TO_RGB_PRESS(top_rgb_toglayers, "GATEWAY; USED FOR COMBOS", GATE, RGB_GATE)
        TO_RGB_PRESS(top_rgb_gtog, "GAMEGATE; USED FOR COMBOS", GG8, RGB_GG8)
    };
    blnk: blnk {
                compatible = "zmk,behavior-macro-one-param";
                label = "Configurable Blink";
                #binding-cells = <1>;
                wait-ms = <0>;
                tap-ms  = <0>;
                bindings = <
                &macro_param_1to1
                &macro_tap &kp MACRO_PLACEHOLDER
                BLINK_SEQ(RGB_BLINK_ON, RGB_XTRA, 80)
                >;
            };
    /* ---- (optional) BLINK/STATUS MACROS ---- */
    // EXPERIMENTAL (STANDALONE)
        KP_BLINK(c_blink, "CAPS LOCK + BLINK", CAPS, RGB_C_BLINK_ON, RGB_ABC, 80)
        KP_BLINK(n_blink, "NUM LOCK + BLINK", KP_NUMLOCK, RGB_N_BLINK_ON, RGB_ABC, 80)
    /* ---- STEP 4: BEHAVIORS - HOLD-TAP ---- 
                    Sub-Layouts; These Exist Under Sub-Bases*/
    behaviors {
        RGB_HT(RGB_ht_xtr, "RGB HT Base_SubLayout1", mo_rgb_xtra)
        RGB_HT(RGB_ht_xtr2, "RGB HT Base_SubLayout2", mo_rgb_xtra2)
        RGB_HT(RGB_ht_xtra4, "RGB HT Base_SubLayout3", mo_rgb_xtr4)
        RGB_HT(RGB_ht_xtr3, "RGB HT Base_SubLayout4", mo_rgb_xtr3)
        RGB_HT(RGB_ht_g1_s1, "RGB HT Game1_1", mo_rgb_g1_s1)
        RGB_HT(RGB_ht_g2_s1, "RGB HT Game2_1", mo_rgb_g2_s1)
        RGB_HT(RGB_ht_g3_s1, "RGB HT Game3_1", mo_rgb_g3_s1)
        RGB_HT(RGB_ht_g4_s1, "RGB HT Game4_1", mo_rgb_g4_s1)
        RGB_HT(RGB_ht_t1_s1, "RGB HT Base1_1", mo_rgb_t1_s1)
        RGB_HT(RGB_ht_t1_s2, "RGB HT Base1_2", mo_rgb_t1_s2)
        RGB_HT(RGB_ht_t1_s3, "RGB HT Base1_3", mo_rgb_t1_s3)
        RGB_HT(RGB_ht_t1_s4, "RGB HT Base1_4", mo_rgb_t1_s4)
        RGB_HT(RGB_ht_t2_s1, "RGB HT Base2_1", mo_rgb_t2_s1)
        RGB_HT(RGB_ht_t2_s2, "RGB HT Base2_2", mo_rgb_t2_s2)
        RGB_HT(RGB_ht_t2_s3, "RGB HT Base2_3", mo_rgb_t2_s3)
        RGB_HT(RGB_ht_t2_s4, "RGB HT Base2_4", mo_rgb_t2_s4)

        hm: homerow_mods {
                    compatible = "zmk,behavior-hold-tap";
                    label = "HOMEROW_MODS";
                    #binding-cells = <2>;
                    tapping-term-ms = <200>;
                    quick_tap_ms = <0>;
                    flavor = "tap-preferred";
                    bindings = <&kp>, <&kp>;
                    quick-tap-ms = <180>;
                    global-quick-tap;
                };

        ltq: ltq {
                    compatible = "zmk,behavior-hold-tap";
                    label = "LTQ";
                    bindings = <&mo>, <&kp>;
                    #binding-cells = <2>;
                    tapping-term-ms = <600>;
                    global-quick-tap;
                    quick-tap-ms = <400>;
                };

        td_numcaps: td_numcaps {
                    compatible = "zmk,behavior-tap-dance";
                    #binding-cells = <0>;
                    tapping-term-ms = <300>;
                    bindings = <&kp LSFT>, <&c_blink>, <&n_blink>;
                };
    };
    /* ---- (OPTIONAL) STEP 5: COMBOS ---- */
    combos {
        compatible = "zmk,combos";
        CMB(left_bkt, &kp LEFT_BRACKET, 4 3, ABC);
        CMB(right_bkt, &kp RBKT, 7 8, ABC);
        CMB(left_par, &kp LEFT_PARENTHESIS, 15 16, ABC);
        CMB(right_par, &kp RIGHT_PARENTHESIS, 19 20, ABC);
        CMB(left_brace, &kp LEFT_BRACE, 27 28, ABC);
        CMB(right_brace, &kp RIGHT_BRACE, 32 31, ABC);
        CMB(bac, &kp BACKSLASH, 5 6, ABC);
        CMB(pipe, &kp PIPE, 17 18, ABC);
        //Pathing
        // Gateways
        CMB(toggleLayer, &top_rgb_toglayers, 55 56, ABC T1 T2);
        CMB(game_toggle, &top_rgb_gtog, 55 56, GAME GME2 GME3 GME4);
        // To (Sub)Base
        CMB(gameLayer_2_BaseLayer, &to_rgb_default, 0 11, GAME);
        CMB(gameLayer, &to_rgb_game, 0 11, ABC GATE GME2 GME3 GME4);
        // "Exit" Combos; Return to (Sub)Base
        CMB(toggleLayer_2_BaseLayer, &to_rgb_default, 55 56, GATE);
        CMB(game_toggle_2_game, &to_rgb_game, 55 56, GG8);
    };
 };
